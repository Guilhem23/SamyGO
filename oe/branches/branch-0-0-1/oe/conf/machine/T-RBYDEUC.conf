## oe/branches/branch-0-0-1/oe/conf/machine/T-RBYDEUC.conf
```bitbake
#@TYPE: Machine
#@NAME: Samsung TV-OS  
#@DESCRIPTION: Machine Configuration for a lot of Samsung TV's (LCD, LED & Plasma [LExxA75x, LExxA85x, LExxA95x, LExxA965])

TARGET_ARCH = "sh4"
UBOOT_MACHINE = "ssa1fpga_board_config"
# IPKG_ARCHS = "all sh ${MACHINE}"
# IPKG_EXTRA_ARCHS += "sh4 sh4a"

require conf/machine/include/st.conf
# require conf/machine/include/tune-sh4.conf
# 2.6.17.14_stm22_0039-Samsung_7103 preempt mod_unload SH4LE gcc-4.1
MACHINE_KERNEL_VERSION = "2.6"
# MACHINE_FEATURES += "bluetooth nfs wifi usbhost"

PREFERRED_VERSION_linux-st = "2.6.17.14"
PREFERRED_VERSION_samsung-firmware = "1013.1+Samsung"
PREFERRED_VERSION_ffmpeg = "0.5.0+svnr20244"
PREFERRED_VERSION_u-boot = "p750"
```

## oe/branches/branch-0-0-1/oe/conf/machine/T-SPHAUSC.conf
```bitbake
#@TYPE: Machine
#@NAME: Samsung TV-OS  
#@DESCRIPTION: Machine Configuration for a lot of Samsung TV's (LCD, LED & Plasma) [LNxxA850, LNxxA860]

TARGET_ARCH = "arm"
UBOOT_MACHINE = "leonid_config" # correct one? * Arris *
# UBOOT_MACHINE = "polaris_config" # may the correct one but build fail polaris.c:24: error: 'MACH_TYPE_ADONIS' undeclared (first use in this function) * Arris *
# TARGET_BOARD = "leonid..." # have to implement later
# IPKG_ARCHS = "all arm ${MACHINE}" # For What?
# IPKG_EXTRA_ARCHS += "armv4 armv5te armv6 armv7"

require conf/machine/include/chelsea.conf
# require conf/machine/include/tune-arm926ejs.conf
# MACHINE_KERNEL_VERSION = "2.6.18_SELP-ARM"
MACHINE_KERNEL_VERSION = "2.6"
# MACHINE_FEATURES += "bluetooth nfs wifi usbhost"

PREFERRED_VERSION_linux-chelsea = "2.6.18"
PREFERRED_VERSION_linux-libc-headers = "2.6.18-r17"

PREFERRED_VERSION_samsung-firmware = "UNKNOWN"
# PREFERRED_VERSION_ffmpeg = "0.4.9-pre1"
# PREFERRED_VERSION_ffmpeg = "0.4.9-pre1+ffplay"
PREFERRED_VERSION_ffmpeg = "0.5.0+svnr20244"
PREFERRED_VERSION_u-boot = "b650"
PREFERRED_VERSION_u-boot-mkimage-selp-native = "b650"

# Overwrite glibc from chelsea.conf
# PREFERRED_VERSION_glibc = "2.3.3-4.0.1"
# PREFERRED_VERSION_glibc-intermediate = "2.3.3-4.0.1"
```

## oe/branches/branch-0-0-1/oe/conf/machine/T-STL5PAUSFC.conf
```bitbake
#@TYPE: Machine
#@NAME: Samsung TV-OS
#@DESCRIPTION: Machine Configuration for a lot of Samsung TV's (LCD, LED & Plasma [PN50B530 PN58B550])

require conf/machine/T-CHU7DEUC.conf

PREFERRED_VERSION_samsung-firmware = "1021.1+Samsung"
```

## oe/branches/branch-0-0-1/oe/conf/machine/T-TDT5DEUC.conf
```bitbake
#@TYPE: Machine
#@NAME: Samsung TV-OS  
#@DESCRIPTION: Machine Configuration for a lot of Samsung TV's (CI+? LCD, LED & Plasma 2010 Series [LE40C530F1WXXU]T-TDT5DEUC)
# 
#
# LE32C450
# sudo modinfo squashfs-root/lib/modules/rfs.ko
# filename:       squashfs-root/lib/modules/rfs.ko
# license:        Samsung, Proprietary
# depends:        
# vermagic:       2.6.18_SELP.4.2.x-hidtv_sx-mips24ke_nfp_be preempt mod_unload MIPS32_R2 32BIT gcc-4.2
#
TARGET_ARCH = "arm"
require conf/machine/include/trihidtv.conf
# cpu 425M or 350M?

KERNEL_LOCALVERSION_append = ".4.2.x-hidtv_sx-mips24ke_nfp_be"

MACHINE_CLASS = "trihidtv"
FIRMWARE_CLASS = "${MACHINE}"
UBOOT_MACHINE = "aquila_config"

MACHINE_KERNEL_VERSION = "2.6"
# MACHINE_FEATURES += "bluetooth nfs wifi usbhost"

PREFERRED_VERSION_samsung-firmware = "1016.1+Samsung"
# PREFERRED_VERSION_samsung-firmware = "1009.0+Svalencia"
# T-TDT5DEUC-1019.0 Mips???
PREFERRED_VERSION_samsung-firmware = "1019.0+Samsung"

PREFERRED_VERSION_ffmpeg = "0.5.0+svnr20244"
PREFERRED_VERSION_u-boot = "b650"
PREFERRED_VERSION_u-boot-mkimage-selp-native = "b650"

# PREFERRED_VERSION_StarterLib = "0.03.0"
#
#
# need to find currect compiler for opt.
# require conf/machine/include/tune-mips32.inc
```

## oe/branches/branch-0-0-1/oe/conf/machine/include/chelsea.conf
```bitbake
# Gone from main Makefile
TARGET_OS = linux-gnueabi

MACHINE_TASK_PROVIDER = "task-samsung"

PREFERRED_PROVIDERS += "virtual/${TARGET_PREFIX}gcc-initial:gcc-cross-initial"
PREFERRED_PROVIDERS += "virtual/${TARGET_PREFIX}gcc:gcc-cross"
PREFERRED_PROVIDERS += "virtual/${TARGET_PREFIX}g++:gcc-cross"

#EABI stuff
PREFERRED_PROVIDER_virtual/${TARGET_PREFIX}-libc-for-gcc = "glibc-intermediate"

PREFERRED_PROVIDER_virtual/libsdl = "SDL-Samsung"
PREFERRED_PROVIDER_virtual/libx11 = "SDL-Samsung"
PREFERRED_PROVIDER_xserver = "xserver-kdrive"
PREFERRED_PROVIDER_virtual/kernel = "linux-chelsea"

MACHINE_FEATURES = "kernel26"
TARGET_FPU = "soft"
OLDEST_KERNEL = "2.6.18"
KERNEL_IMAGETYPE = "uImage"
EXTRA_IMAGEDEPENDS += "u-boot"

#use EABI toolchain
PREFERRED_VERSION_gcc = "4.2.0-4.0.9"
PREFERRED_VERSION_gcc-cross = "4.2.0-4.0.9"
PREFERRED_VERSION_gcc-cross-initial = "4.2.0-4.0.9"
PREFERRED_VERSION_binutils = "2.17.50"
PREFERRED_VERSION_binutils-cross = "2.17.50"
PREFERRED_VERSION_linux-libc-headers = "2.6.18"
PREFERRED_VERSION_glibc = "2.5.90-9.0.9"
PREFERRED_VERSION_glibc-intermediate = "2.5.90-9.0.9"
```

## oe/branches/branch-0-0-1/oe/conf/machine/include/st.conf
```bitbake
# Gone from main Makefile
TARGET_OS = linux

MACHINE_TASK_PROVIDER = "task-samsung"

PREFERRED_PROVIDERS += "virtual/${TARGET_PREFIX}gcc-initial:gcc-cross-initial"
PREFERRED_PROVIDERS += "virtual/${TARGET_PREFIX}gcc:gcc-cross"
PREFERRED_PROVIDERS += "virtual/${TARGET_PREFIX}g++:gcc-cross"

PREFERRED_PROVIDER_virtual/libsdl = "SDL-Samsung"
PREFERRED_PROVIDER_virtual/libx11 = "SDL-Samsung"
PREFERRED_PROVIDER_xserver = "xserver-kdrive"
PREFERRED_PROVIDER_virtual/kernel = "linux-st"
# 2.6.17.14_stm22_0039-Samsung_7103

MACHINE_FEATURES = "kernel26"
TARGET_FPU = ""
OLDEST_KERNEL = "2.6.11"
KERNEL_IMAGETYPE = "uImage"
# EXTRA_IMAGEDEPENDS += "u-boot"

# Kernel is compiled with 4.1.1 (we request extra compiler from linux.st*.bb)
# PREFERRED_VERSION_gcc = "4.1.1"
# PREFERRED_VERSION_gcc-cross = "4.1.1"
# PREFERRED_VERSION_gcc-cross-initial = "4.1.1"
PREFERRED_VERSION_binutils = "2.17.50.0.4"
PREFERRED_VERSION_binutils-cross = "2.17.50.0.4"
PREFERRED_VERSION_linux-libc-headers = "2.6.17.14"
PREFERRED_VERSION_glibc = "2.5.0-2.7.0"
PREFERRED_VERSION_glibc-initial = "2.5.0-2.7.0"
PREFERRED_VERSION_glibc-intermediate = "2.5.0-2.7.0"

# Testing 4.2/4.1-20060217
# PREFERRED_VERSION_gcc = "4.1-20060217"
# PREFERRED_VERSION_gcc-cross = "4.1-20060217"
# PREFERRED_VERSION_gcc-cross-initial = "4.1-20060217"
PREFERRED_VERSION_gcc = "4.2.0-4.0.9"
PREFERRED_VERSION_gcc-cross = "4.2.0-4.0.9"
PREFERRED_VERSION_gcc-cross-initial = "4.2.0-4.0.9"
```

## oe/branches/branch-0-0-1/oe/conf/machine/include/trihidtv.conf
```bitbake
# default is yes?
# THUMB_INTERWORK = "no"
TARGET_ARCH = "mips"
# get sane-toolchain include happy for eabi without include a tune file
# but if tuned no blame about double definitions
# TARGET_ARCH = "armv4te"

PREFERRED_PROVIDER_virtual/libsdl = "libsdl-selp"
# PREFERRED_VERSION_libsdl-x11 = "1.2.14"
PREFERRED_PROVIDER_virtual/libx11 = "libsdl-selp"
PREFERRED_PROVIDER_xserver = "virtual/xserver"
PREFERRED_PROVIDER_virtual/kernel = "linux-trihidtv"
PREFERRED_VERSION_linux-trihidtv = "2.6.18"
# add extra strings in machine config! (used for kernel and modules) 
KERNEL_LOCALVERSION = "_SELP"

MACHINE_FEATURES = "kernel26"
OLDEST_KERNEL_linux-gnueabi = "2.6.18"
OLDEST_KERNEL = "2.6.18"
# uzImage needs test * Arris *
# KERNEL_IMAGETYPE = "uzImage"
KERNEL_IMAGETYPE = "uImage"
# temporary disableu-bootdepend.
KERNEL_IMAGETYPE = "Image"
KERNEL_IMAGETYPE = "zImage"
# EXTRA_IMAGEDEPENDS += "u-boot"


# /dev/bml0/5
KERNEL_IMAGE_MAXSIZE = "4194304"

# /dev/bml0/6 mounted as /dev/tbml6
ROOTFS_MAXSIZE = "4194304"

# /dev/bml0/7
BOOTFS_MAXSIZE = "2097152"

# /dev/bml0/8 & 10
EXEFS_MAXSIZE = "62914560"

# /dev/bml0/9 & 11
APPDATEFS_MAXSIZE = "47185920"

# /dev/bml0/3
UBOOT_ENV_MAXSIZE = "524288"

# /dev/bml0/2
UBOOT_MAXSIZE = "524288"

# /dev/bml0/4
FNW_MAXSIZE = "524288"

# /dev/bml0/12 write with dd ??? and mounted as /dev/stl0/12 ???
# cat /mtd_tlib/tlibversioninfo.txt -> TLIB EU 2G 2009-03-20-01
TLIB_MAXSIZE = "471859200"
# /dev/stl0/12 439353344 

# wiselink? mounted as /dev/stl1/3
# /dev/stl1/3 919601152


#use EABI toolchain
# needs to include sane-toolchain
PREFERRED_BINUTILS = "2.17.50"
PREFERRED_GCC_VERSION = "4.2.0-4.0.9"
PREFERRED_VERSION_glibc = "2.5.90-19.0.46"
PREFERRED_VERSION_glibc-initial = "2.5.90-19.0.46"
PREFERRED_VERSION_glibc-intermediate = "2.5.90-19.0.46"

PREFERRED_VERSION_gcc-cross-sdk = "${PREFERRED_GCC_VERSION}" 

GLIBC_ADDONS = "ports,nptl"

PREFERRED_VERSION_linux-libc-headers = "2.6.18"
```

## oe/branches/branch-0-0-1/oe/conf/machine/include/tune-cortexa8.conf
```bitbake
# Instead of using -mfpu=vfp we can use -mfpu=neon to make use of gcc intrinsics 
# and vectorize loops with -ftree-vectorize
# http://gcc.gnu.org/onlinedocs/gcc/ARM-NEON-Intrinsics.html
# http://gcc.gnu.org/onlinedocs/gcc/ARM-Options.html
# https://support.codesourcery.com/GNUToolchain/kbentry29

# TARGET_CC_ARCH = "-march=armv7-a -mtune=cortex-a8 -mfpu=neon -mfloat-abi=softfp"
TARGET_CC_ARCH = "-march=armv7-a -mtune=cortex-a8 -mfpu=vfp -mfloat-abi=softfp"
# Other potentially useful options
#-ftree-vectorize -ffast-math -fno-omit-frame-pointer
MACHINE_FEATURES += "eabi"

# Override the options for some packages
# NONE for now * Arris *

FEED_ARCH = "armv7a"
# seperate some stuff
# PACKAGE_ARCH = "armv7a"
BASE_PACKAGE_ARCH = "armv7a"
PACKAGE_EXTRA_ARCHS += "armv4 armv4t armv5te armv6 armv7 armv7a"

# Include tune file for thumb support, it defaults to off so DISTROs can turn it on if they wish
require conf/machine/include/tune-thumb.conf
```

## oe/branches/exp-redesign-2010-05-26/oe/conf/machine/include/chelsea.conf
```bitbake
MACHINE_FEATURES = "kernel26"
TARGET_FPU = "hard"

require conf/machine/include/tune-arm1136jf-s.inc

require conf/distro/include/toolchain-selp3.2.inc
```

## oe/trunk/oe/conf/distro/include/toolchain-selp3.2.inc
```bitbake
PREFERRED_VERSION_gcc-cross = "4.2.0-4.0.9"
PREFERRED_VERSION_gcc-cross-initial = "4.2.0-4.0.9"
PREFERRED_VERSION_gcc-cross-intermediate = "4.2.0-4.0.9"
PREFERRED_VERSION_binutils = "2.17.50"
PREFERRED_VERSION_binutils-cross = "2.17.50"
PREFERRED_VERSION_linux-libc-headers = "2.6.18"
PREFERRED_VERSION_glibc = "2.5.90-9.0.9"
PREFERRED_VERSION_glibc-initial = "2.5.90-9.0.9"
```

## oe/trunk/oe/conf/distro/samygo-cl.conf
```bitbake
#@TYPE: Distribution
#@NAME: samygo-cl
#@DESCRIPTION: Distribution configuration for SamyGO Content Library Games
MAINTAINER = "SamyGO Team"

require conf/distro/samygo.conf

TARGET_VENDOR = "-cl"
```

## oe/trunk/oe/conf/distro/samygo.conf
```bitbake
#@TYPE: Distribution
#@NAME: samygo 
#@DESCRIPTION: Distribution configuration for SamyGO
MAINTAINER = "SamyGO Team"

DISTRO_FEATURES = "kernel26"

INHERIT += "insane recipe_sanity sanity debian devshell package_ipk packaged-staging"

PREFERRED_PROVIDERS += "virtual/${TARGET_PREFIX}gcc-initial:gcc-cross-initial"
PREFERRED_PROVIDERS += " virtual/${TARGET_PREFIX}gcc-intermediate:gcc-cross-intermediate"
PREFERRED_PROVIDERS += " virtual/${TARGET_PREFIX}gcc:gcc-cross"
PREFERRED_PROVIDERS += " virtual/${TARGET_PREFIX}g++:gcc-cross"

PREFERRED_PROVIDER_opkg = "opkg-nogpg-nocurl"
PREFERRED_PROVIDER_hotplug = "busybox-mdev"

PREFERRED_PROVIDER_virtual/update-alternatives = "opkg-nogpg-nocurl"
PREFERRED_PROVIDER_virtual/update-alternatives-native = "opkg-native"

IPKG_VARIANT = "opkg-nogpg-nocurl"

IMAGE_DEV_MANAGER = "busybox-mdev"

require conf/distro/include/glibc.inc

OPKG_SRCREV ?= "529"

LIMIT_BUILT_LOCALES ?= "en_GB"

USE_NLS = "no"

USE_VT = "0"
SYSVINIT_ENABLED_GETTYS = "1"

SERIAL_CONSOLE = "115200 ttyS1"

DISTRO_XORG_CONFIG_MANAGER = "busybox-mdev"

USE_NLS = "no"
USE_NLS_glib-2.0 = "yes"
USE_NLS_glib-2.0-native = "yes"
USE_NLS_gcc-cross = "no"
```

## oe/trunk/oe/conf/distro/selp.conf
```bitbake
#@TYPE: Distribution
#@NAME: selp 
#@DESCRIPTION: Distribution configuration for SELP
MAINTAINER = "SamyGO Team"

USE_NLS = "no"

INHERIT += "package_ipk debian"

SYSVINIT_ENABLED_GETTYS = ""

DISTRO_FEATURES = "nfs smbfs wifi bluetooth ext2 usbhost"

PREFERRED_PROVIDERS += "virtual/${TARGET_PREFIX}gcc-initial:gcc-cross-initial"
PREFERRED_PROVIDERS += "virtual/${TARGET_PREFIX}gcc:gcc-cross"
PREFERRED_PROVIDERS += "virtual/${TARGET_PREFIX}g++:gcc-cross"

#EABI stuff
PREFERRED_PROVIDER_virtual/${TARGET_PREFIX}-libc-for-gcc = "glibc-intermediate"
MACHINE_KERNEL_VERSION = "2.6"

DISTRO = "selp"
DISTRO_NAME = "SELP"

DISTRO_FEATURES = "kernel26"

#EABI stuff
PREFERRED_PROVIDER_virtual/${TARGET_PREFIX}-libc-for-gcc = "glibc-intermediate"
PREFERRED_PROVIDER_virtual/arm-unknown-linux-gnueabi-libc-for-gcc = "glibc-intermediate"
PREFERRED_PROVIDER_virtual/arm-linux-libc-for-gcc = "glibc-intermediate"
PREFERRED_PROVIDER_virtual/libc     = "glibc"
PREFERRED_PROVIDER_virtual/libiconv = "glibc"
PREFERRED_PROVIDER_virtual/libintl  = "glibc"

#
# Original Firmware
# PREFERRED_PROVIDER_virtual/libc = "samsung-firmware"

#
#use EABI toolchain
PREFERRED_VERSION_gcc-cross = "4.2.0-4.0.9"
PREFERRED_VERSION_gcc-cross-initial = "4.2.0-4.0.9"
PREFERRED_VERSION_binutils = "2.17.50"
PREFERRED_VERSION_binutils-cross = "2.17.50"
PREFERRED_VERSION_linux-libc-headers = "2.6.18"
PREFERRED_VERSION_glibc = "2.5.90-9.0.9"
PREFERRED_VERSION_glibc-intermediate = "2.5.90-9.0.9"

GLIBC_BROKEN_LOCALES = "a b c d f g h i j k l m n o p q r s t u v w x y z"

IMAGE_DEVICE_TABLE = ""
```

## oe/trunk/oe/conf/machine/T-CHU7DEUC.conf
```bitbake
#@TYPE: Machine
#@NAME: Samsung TV-OS  
#@DESCRIPTION: Machine Configuration for a lot of Samsung TV's (LCD, LED & Plasma [UExxBxxxx])

TARGET_ARCH = "arm"
UBOOT_MACHINE = "leonid_config"
# TARGET_BOARD = "leonid..." # have to implement later
# IPKG_ARCHS = "all arm ${MACHINE}" # For What?
# IPKG_EXTRA_ARCHS += "armv4 armv5te armv6 armv7"

require conf/machine/include/chelsea.conf
# require conf/machine/include/tune-arm926ejs.conf
# MACHINE_KERNEL_VERSION = "2.6.18_SELP-ARM"
MACHINE_KERNEL_VERSION = "2.6"
# MACHINE_FEATURES += "bluetooth nfs wifi usbhost"

# PREFERRED_VERSION_linux-chelsea = "2.6.18-r24"
PREFERRED_VERSION_linux-chelsea = "2.6.18"
MACHINE_KERNEL_CONFIG_CMD_ARGS = "2 2 2.6.18_SELP-ARM"
PREFERRED_VERSION_samsung-firmware = "2008.2+Samsung"
# PREFERRED_VERSION_ffmpeg = "0.4.9-pre1"
# PREFERRED_VERSION_ffmpeg = "0.4.9-pre1+ffplay"
PREFERRED_VERSION_ffmpeg = "0.5.0+svnr20244"
PREFERRED_VERSION_u-boot = "b650"
# PREFERRED_VERSION_xproto = "7.0.10"
# PREFERRED_VERSION_diet-x11 = "X11R7.0-1.0.0"
```

## oe/trunk/oe/conf/machine/T-SPHAUSC.conf
```bitbake
#@TYPE: Machine
#@NAME: Samsung TV-OS  
#@DESCRIPTION: Machine Configuration for a lot of Samsung TV's (LCD, LED & Plasma) [LNxxA850, LNxxA860]

TARGET_ARCH = "arm"
UBOOT_MACHINE = "ssa1fpga_board_config" # correct one? * Arris *
# TARGET_BOARD = "leonid..." # have to implement later
# IPKG_ARCHS = "all arm ${MACHINE}" # For What?
# IPKG_EXTRA_ARCHS += "armv4 armv5te armv6 armv7"

require conf/machine/include/chelsea.conf
# require conf/machine/include/tune-arm926ejs.conf
# MACHINE_KERNEL_VERSION = "2.6.18_SELP-ARM"
MACHINE_KERNEL_VERSION = "2.6"
# MACHINE_FEATURES += "bluetooth nfs wifi usbhost"

PREFERRED_VERSION_linux-chelsea = "2.6.18"
PREFERRED_VERSION_samsung-firmware = "1004.0+Samsung"
# PREFERRED_VERSION_ffmpeg = "0.4.9-pre1"
# PREFERRED_VERSION_ffmpeg = "0.4.9-pre1+ffplay"
PREFERRED_VERSION_ffmpeg = "0.5.0+svnr20244"
PREFERRED_VERSION_u-boot = "p750"
# PREFERRED_VERSION_xproto = "7.0.10"
# PREFERRED_VERSION_diet-x11 = "X11R7.0-1.0.0"
```

## oe/trunk/oe/conf/machine/include/chelsea.conf
```bitbake
PREFERRED_PROVIDER_virtual/kernel = "linux-chelsea"

MACHINE_FEATURES = "kernel26"
TARGET_FPU = ""

require conf/machine/include/tune-arm1136jf-s.inc

require conf/distro/include/toolchain-selp3.2.inc
```

## oe/trunk/oe/conf/machine/include/cip.open.conf
```bitbake
MACHINE_TASK_PROVIDER = "task-base"
PREFERRED_PROVIDER_xserver = "xserver-kdrive"
REFERRED_PROVIDER_virtual/kernel = "linux-cip.open"

MACHINE_FEATURES = "kernel26"
TARGET_FPU = ""
OLDEST_KERNEL = "2.6.11"
```
