## oe/trunk/oe/conf/machine/include/st.conf
```bitbake
PREFERRED_PROVIDER_virtual/kernel = "linux-st"
# 2.6.17.14_stm22_0039-Samsung_7103

MACHINE_FEATURES = "kernel26"
TARGET_FPU = ""
```

## oe/trunk/oe/conf/machine/sdp75.conf
```bitbake
#@TYPE: Machine
#@NAME: Samsung TV-OS  
#@DESCRIPTION: Machine Configuration for Samsung TV's [LNxxA750, LNxxA850, LNxxA860]

TARGET_ARCH = "arm"
UBOOT_MACHINE = "polaris_config"

require conf/machine/include/chelsea.conf
MACHINE_KERNEL_VERSION = "2.6"

PREFERRED_VERSION_linux-chelsea = "2.6.18"
PREFERRED_VERSION_u-boot = "p750"
PREFERRED_VERSION_u-boot-mkimage-selp-native = "p750"

FIRMWARE_NAME = "T-UNKNOWN"
```

## oe/trunk/oe/conf/machine/sdp83.conf
```bitbake
#@TYPE: Machine
#@NAME: Samsung TV-OS  
#@DESCRIPTION: Machine Configuration for a lot of Samsung TV's (LCD, LED & Plasma [UExxBxxxx])

TARGET_ARCH = "arm"
UBOOT_MACHINE = "leonid_config"

require conf/machine/include/chelsea.conf
MACHINE_KERNEL_VERSION = "2.6"

PREFERRED_VERSION_linux-chelsea = "2.6.18"
PREFERRED_VERSION_u-boot = "b650"
PREFERRED_VERSION_u-boot-mkimage-selp-native = "b650"

FIRMWARE_NAME = "T-UNKNOWN"
```
