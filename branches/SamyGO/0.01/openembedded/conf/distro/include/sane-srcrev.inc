## branches/SamyGO/0.01/openembedded/conf/distro/include/sane-srcrev.inc
```bitbake
# Lock down some SRCREV, see http://svn.o-hand.com/view/poky/trunk/openembedded/conf/distro/poky.conf for the original version 

SRCREV_mplayer ?= "20060814"
SRCREV_ffmpeg ?= "20244"
```

## branches/SamyGO/0.01/openembedded/conf/distro/selp-3.2.conf
```bitbake
# Maintainer: Ser Lev Arris <arris@ZsoltTech.Com>

include conf/distro/selp.conf
DISTRO = "selp"
DISTRO_NAME = "SELP"
DISTRO_VERSION = "3.2"

# FEED_URIS += "devel##http://stb.zsolttech.com/SamyGO"

DISTRO_FEATURES += "kernel26"

#EABI stuff
PREFERRED_PROVIDER_virtual/${TARGET_PREFIX}-libc-for-gcc = "glibc-intermediate"
PREFERRED_PROVIDER_virtual/arm-unknown-linux-gnueabi-libc-for-gcc = "glibc-intermediate"
PREFERRED_PROVIDER_virtual/arm-linux-libc-for-gcc = "glibc-intermediate"
# PREFERRED_PROVIDER_virtual/libc     = "glibc"
# PREFERRED_PROVIDER_virtual/libiconv = "glibc"
# PREFERRED_PROVIDER_virtual/libintl  = "glibc"

#
# Original Firmware
# PREFERRED_PROVIDER_virtual/libc = "samsung-firmware"

#
#use EABI toolchain
# PREFERRED_VERSION_gcc = "4.2.0-4.0.9"
PREFERRED_VERSION_gcc-cross = "4.2.0-4.0.9"
PREFERRED_VERSION_gcc-cross-initial = "4.2.0-4.0.9"
PREFERRED_VERSION_binutils = "2.17.50"
PREFERRED_VERSION_binutils-cross = "2.17.50"
PREFERRED_VERSION_linux-libc-headers = "2.6.18"
PREFERRED_VERSION_glibc = "2.5.90-9.0.9"
PREFERRED_VERSION_glibc-intermediate = "2.5.90-9.0.9"

PREFERRED_VERSION_python = "2.5.1-ml5"
# PREFERRED_VERSION_python = "2.6.1"

GLIBC_BROKEN_LOCALES = "a b c d f g h i j k l m n o p q r s t u v w x y z"
```

## oe/branches/branch-0-0-1/oe/conf/distro/samygo-3.2.conf
```bitbake
# Maintainer: Ser Lev Arris <arris@ZsoltTech.Com>

include conf/distro/samygo.conf
DISTRO = "samygo"
DISTRO_NAME = "SamyGO"
DISTRO_VERSION = "3.2"

# FEED_URIS += "devel##http://stb.zsolttech.com/SamyGO"

DISTRO_FEATURES += "kernel26"

# Version from Distro overwrites Version from Machine?
PREFERRED_VERSION_python = "2.5.1-ml5"
# PREFERRED_VERSION_python = "2.6.1"

GLIBC_BROKEN_LOCALES = "a b c d f g h i j k l m n o p q r s t u v w x y z"
```

## oe/branches/branch-0-0-1/oe/conf/distro/samygo.conf
```bitbake
#@TYPE: Distribution
#@NAME: samygo 
#@DESCRIPTION: SamyGO Distribution configuration for Samsung TV's 

require conf/distro/include/sane-srcdates.inc
# Test if eabi is ok
# require conf/distro/include/angstrom-glibc.inc

# MAINTAINER = "Ser Lev Arris <arris@ZsoltTech.Com>"
STAGING_PYDIR = "${STAGING_DIR}/lib/python2.6"
ENTERPRISE_DISTRO = "1"

USE_NLS = "no"

# INHERIT += "package_rpm debian"
INHERIT += "package_ipk debian"

SYSVINIT_ENABLED_GETTYS = ""

DISTRO_FEATURES = "nfs smbfs wifi bluetooth ext2 usbhost"

MACHINE_KERNEL_VERSION = "2.6"
# PREFERRED_VERSION_samba = "3.3.0"

PREFERRED_PROVIDER_virtual/libiconv = "glibc"
PREFERRED_PROVIDER_virtual/libintl = "glibc"
# possible provider * Arris *
# PREFERRED_PROVIDER_virtual/libiconv = "libiconv"
# PREFERRED_PROVIDER_virtual/libintl = "proxy-libintl"
# PREFERRED_PROVIDER_virtual/libintl = "gettext"
#
```

## oe/branches/branch-0-0-1/oe/conf/machine/T-AMBDFRC.conf
```bitbake
#@TYPE: Machine
#@NAME: Samsung TV-OS
#@DESCRIPTION: Machine Configuration for a lot of Samsung TV's (LCD, LED & Plasma [LExxA676])

require conf/machine/T-RBYDEUC.conf

# 2.6.17.14_stm22_0039-Samsung_7103 preempt mod_unload SH4LE gcc-4.1
PREFERRED_VERSION_samsung-firmware = "1017.0+Samsung"
```

## oe/branches/branch-0-0-1/oe/conf/machine/T-AMBPEUMD.conf
```bitbake
#@TYPE: Machine
#@NAME: Samsung TV-OS
#@DESCRIPTION: Machine Configuration for a lot of Samsung TV's (LCD, LED & Plasma [LExxA656])

require conf/machine/T-RBYDEUC.conf

# firm is .bin arch unknown * Arris * 
PREFERRED_VERSION_samsung-firmware = "1023.0+Samsung"
```

## oe/branches/branch-0-0-1/oe/conf/machine/T-CHE6AUSC.conf
```bitbake
#@TYPE: Machine
#@NAME: Samsung TV-OS
#@DESCRIPTION: Machine Configuration for a lot of Samsung TV's (LCD, LED & Plasma [LNxxB63x])

require conf/machine/T-CHU7DEUC.conf

PREFERRED_VERSION_samsung-firmware = "1014.0+Samsung"
```

## oe/branches/branch-0-0-1/oe/conf/machine/T-CHE7AUSC.conf
```bitbake
#@TYPE: Machine
#@NAME: Samsung TV-OS
#@DESCRIPTION: Machine Configuration for a lot of Samsung TV's (LCD, LED & Plasma [UNxxB7xxx, UNxxB8xxx])

# may conf/machine/T-CHEAUSC.conf
require conf/machine/T-CHU7DEUC.conf

PREFERRED_VERSION_samsung-firmware = "1013.0+Samsung"
MACHINE_KERNEL_CONFIG_CMD_ARGS = "2 1 2.6.18_SELP-ARM"
```

## oe/branches/branch-0-0-1/oe/conf/machine/T-CHEAEAC.conf
```bitbake
#@TYPE: Machine
#@NAME: Samsung TV-OS
#@DESCRIPTION: Machine Configuration for a lot of Samsung TV's (LCD, LED & Plasma [LAxxB75x]?)

oefatal "not clear what firmware or type"

require conf/machine/T-CHU7DEUC.conf

PREFERRED_VERSION_samsung-firmware = "2005.0+Samsung"
```

## oe/branches/branch-0-0-1/oe/conf/machine/T-CHEAUSC.conf
```bitbake
#@TYPE: Machine
#@NAME: Samsung TV-OS
#@DESCRIPTION: Machine Configuration for a lot of Samsung TV's (LCD, LED & Plasma [LNxxB65x, PNxxB65x, LNxxB75x])

require conf/machine/T-CHU7DEUC.conf

PREFERRED_VERSION_samsung-firmware = "1012.3+Samsung"
```

## oe/branches/branch-0-0-1/oe/conf/machine/T-CHL5CIPDSEUC.conf
```bitbake
#@TYPE: Machine
#@NAME: Samsung TV-OS  
#@DESCRIPTION: Machine Configuration for a lot of Samsung TV's (CI+!!! LCD, LED & Plasma [LE40B579])

#(Samsung B579) http://sourceforge.net/apps/phpbb/samygo/viewtopic.php?f=4&t=247#p1794

require conf/machine/T-CHU7DEUC.conf

# It's ok to use def. chelsea kernel
# PREFERRED_PROVIDER_virtual/kernel = "linux-cip"
# PREFERRED_VERSION_linux-cip = "2.6.18"
# MACHINE_KERNEL_CONFIG_CMD_ARGS = "2 2 2.6.18_SELP-ARM"

PREFERRED_VERSION_samsung-firmware = "cip-1008.0+Samsung"
```

## oe/branches/branch-0-0-1/oe/conf/machine/T-CHL5DEUC.conf
```bitbake
# Out of the box TV has no Networ support and no rj45, so full stuff 
# is to implement for usb-network
#@TYPE: Machine
#@NAME: Samsung TV-OS
#@DESCRIPTION: Machine Configuration for a lot of Samsung TV's (LCD, LED & Plasma [LExxB55x, PSxxB55x, PSxxB56x, LExxB62x, UExxB6xxx])

require conf/machine/T-CHU7DEUC.conf

PREFERRED_VERSION_samsung-firmware = "2008.0+Samsung"
```

## oe/branches/branch-0-0-1/oe/conf/machine/T-CHL6CIPDSEUC.conf
```bitbake
#@TYPE: Machine
#@NAME: Samsung TV-OS
#@DESCRIPTION: Machine Configuration for a lot of Samsung TV's (CI+!!! LCD, LED & Plasma [LExxB679, PS50B679])

require conf/machine/T-CHU7DEUC.conf

# PREFERRED_PROVIDER_virtual/kernel = "linux-cip"
# PREFERRED_VERSION_linux-cip = "2.6.18"
# MACHINE_KERNEL_CONFIG_CMD_ARGS = "2 2 2.6.18_SELP-ARM"

PREFERRED_VERSION_samsung-firmware = "cip-1008.0+Samsung"
```

## oe/branches/branch-0-0-1/oe/conf/machine/T-CHL7DAUC.conf
```bitbake
#@TYPE: Machine
#@NAME: Samsung TV-OS
#@DESCRIPTION: Machine Configuration for a lot of Samsung TV's (LCD, LED & Plasma [LAxxB65x, PSxxB65x, LAxxB75x]?)

require conf/machine/T-CHU7DEUC.conf

PREFERRED_VERSION_samsung-firmware = "2001.1+Samsung"
# there is also 2005.0 ?? * Arris *
# PREFERRED_VERSION_samsung-firmware = "2005.0+Samsung"
```

## oe/branches/branch-0-0-1/oe/conf/machine/T-CHL7DEUC.conf
```bitbake
#@TYPE: Machine
#@NAME: Samsung TV-OS  
#@DESCRIPTION: Machine Configuration for a lot of Samsung TV's (LCD, LED & Plasma [LExxB65x, LExxB75x, PSxxB65x])

require conf/machine/T-CHU7DEUC.conf

PREFERRED_VERSION_samsung-firmware = "2005.0+Samsung"
```

## oe/branches/branch-0-0-1/oe/conf/machine/T-CHLCIPDEUC.conf
```bitbake
#@TYPE: Machine
#@NAME: Samsung TV-OS  
#@DESCRIPTION: Machine Configuration for a lot of Samsung TV's (CI+!!! LCD, LED & Plasma [LExxB65x, LExxB75x, PSxxB65x])

require conf/machine/T-CHU7DEUC.conf

# PREFERRED_PROVIDER_virtual/kernel = "linux-cip"
# PREFERRED_VERSION_linux-cip = "2.6.18"
# MACHINE_KERNEL_CONFIG_CMD_ARGS = "2 2 2.6.18_SELP-ARM"
PREFERRED_VERSION_samsung-firmware = "2006.0+Samsung"
```

## oe/branches/branch-0-0-1/oe/conf/machine/T-CHU7DAUC.conf
```bitbake
#@TYPE: Machine
#@NAME: Samsung TV-OS  
#@DESCRIPTION: Machine Configuration for a lot of Samsung TV's (LCD, LED & Plasma [UAxxB7xxx, UAxxB8xxx])

require conf/machine/T-CHU7DEUC.conf

PREFERRED_VERSION_samsung-firmware = "1008.0+Samsung"
```

## oe/branches/branch-0-0-1/oe/conf/machine/T-CHU7DEUC.conf
```bitbake
#@TYPE: Machine
#@NAME: Samsung TV-OS  
#@DESCRIPTION: Machine Configuration for a lot of Samsung TV's (LCD, LED & Plasma [UExxBxxxx, PSxxB85x])

TARGET_ARCH = "arm"
UBOOT_MACHINE = "leonid_config"
# TARGET_BOARD = "leonid..." # have to implement later
# IPKG_ARCHS = "all arm ${MACHINE}" # For What?
# IPKG_EXTRA_ARCHS += "armv4 armv5te armv6 armv7"

require conf/machine/include/chelsea.conf
# require conf/machine/include/tune-arm926ejs.conf
MACHINE_KERNEL_VERSION = "2.6"
# MACHINE_FEATURES += "bluetooth nfs wifi usbhost"

PREFERRED_VERSION_linux-chelsea = "2.6.18"

MACHINE_KERNEL_CONFIG_CMD_ARGS = "2 2 2.6.18_SELP-ARM"
PREFERRED_VERSION_samsung-firmware = "2008.2+Samsung"
PREFERRED_VERSION_samsung-firmware = "3000.G+Samsung"

PREFERRED_VERSION_ffmpeg = "0.5.0+svnr20244"
PREFERRED_VERSION_u-boot = "b650"
PREFERRED_VERSION_u-boot-mkimage-selp-native = "b650"

# PREFERRED_VERSION_StarterLib = "0.03.0"
```

## oe/branches/branch-0-0-1/oe/conf/machine/T-CRLPEUFC.conf
```bitbake
#@TYPE: Machine
#@NAME: Samsung TV-OS
#@DESCRIPTION: Machine Configuration for a lot of Samsung TV's (LCD, LED & Plasma [LA40B530])

require conf/machine/T-CHU7DEUC.conf

PREFERRED_VERSION_samsung-firmware = "1010.0+Samsung"
```

## oe/branches/branch-0-0-1/oe/conf/machine/T-CRLPEUHC.conf
```bitbake
# "LCD TV LB 450460540650 series Firmware (ver.T-CRLPEUHC-1010.3)" http://www.samsung.com/uk/support/do...Type=D&vType=R 
#@TYPE: Machine
#@NAME: Samsung TV-OS
#@DESCRIPTION: Machine Configuration for a lot of Samsung TV's (LCD, LED & Plasma [LBxxB65x, PSxxB430])

require conf/machine/T-CHU7DEUC.conf

# PREFERRED_VERSION_samsung-firmware = "1010.3+Samsung"

# firm is .bin arch unknown * Arris *
# PS42B430P2W
PREFERRED_VERSION_samsung-firmware = "2004.0+Samsung"
```

## oe/branches/branch-0-0-1/oe/conf/machine/T-CRLPEUWC.conf
```bitbake
#@TYPE: Machine
#@NAME: Samsung TV-OS
#@DESCRIPTION: Machine Configuration for a lot of Samsung TV's (LCD, LED & Plasma [?])
# 1. Title
# Firmware for LE**B55****Q** ,LE**B62****Q**
# 2. Applicable Model
# LE**B55****Q** ,LE**B62****Q**
# 3. Carrier or Corporate Customer 
#
require conf/machine/T-CHU7DEUC.conf

# firm is .bin arch unknown * Arris *
# LE37B550A5W
PREFERRED_VERSION_samsung-firmware = "2004.0+Samsung"
```

## oe/branches/branch-0-0-1/oe/conf/machine/T-CSERIES93.conf
```bitbake
#@TYPE: Machine
#@NAME: Samsung TV-OS  
#@DESCRIPTION: Machine Configuration for a lot of Samsung TV's (CI+? LCD, LED & Plasma [??xxCxxx])

TARGET_ARCH = "arm"
UBOOT_MACHINE = "corona_config"

require conf/machine/include/barcelona.conf
# require conf/machine/include/tune-cortexa8.conf

MACHINE_KERNEL_VERSION = "2.6"
# MACHINE_FEATURES += "bluetooth nfs wifi usbhost"

PREFERRED_VERSION_linux-cip = "2.6.24"

PREFERRED_VERSION_samsung-firmware = "3000.G+Samsung"

PREFERRED_VERSION_ffmpeg = "0.5.0+svnr20244"
PREFERRED_VERSION_u-boot = "b650"
PREFERRED_VERSION_u-boot-mkimage-selp-native = "b650"

# PREFERRED_VERSION_StarterLib = "0.03.0"
```

## oe/branches/branch-0-0-1/oe/conf/machine/T-PRLAUS.conf
```bitbake
#@TYPE: Machine
#@NAME: Samsung TV-OS
#@DESCRIPTION: Machine Configuration for a lot of Samsung TV's (LCD, LED & Plasma [LNxxA530])

require conf/machine/T-SPHAUSC.conf

OLDEST_KERNEL = "2.4.17"
PREFERRED_VERSION_linux-chelsea = "2.6.10"
PREFERRED_VERSION_linux-libc-headers = "2.6.10"

# 2.6.10_mvl401-mt53xx-926ejs preempt ARMv5 gcc-3.4

#use EABI toolchain ?
#PREFERRED_VERSION_gcc = "3.4"
#PREFERRED_VERSION_gcc-cross = "3.4"
#PREFERRED_VERSION_gcc-cross-initial = "3.4"
#PREFERRED_VERSION_binutils = "2.17.50"
#PREFERRED_VERSION_binutils-cross = "2.17.50"
#PREFERRED_VERSION_glibc = "2.5.90-9.0.9"
#PREFERRED_VERSION_glibc-initial = "2.5.90-9.0.9"
#PREFERRED_VERSION_glibc-intermediate = "2.5.90-9.0.9"
#

PREFERRED_VERSION_samsung-firmware = "1007.0+Samsung"
PREFERRED_VERSION_samsung-firmware = "1008.0+Samsung"

# Unknown ? Samsung LN37A530P1F ?
# T-PRLAUS/dimage/boot/rfs.ko
# busybox: ELF 32-bit LSB executable, ARM, version 1 (SYSV), statically linked, for GNU/Linux 2.4.17, stripped
# vermagic:       2.6.10_mvl401-mt53xx-926ejs preempt ARMv5 gcc-3.4
#
# firm on samsung site 1007.0 & 1008.0
```

## oe/branches/branch-0-0-1/oe/conf/machine/T-RBYAUSC.conf
```bitbake
#@TYPE: Machine
#@NAME: Samsung TV-OS  
#@DESCRIPTION: Machine Configuration for a lot of Samsung TV's (LCD, LED & Plasma [LNxxA75x, LNxxA76x])

require conf/machine/T-RBYDEUC.conf
 
PREFERRED_VERSION_samsung-firmware = "1012.2+Samsung"
```
